// generated by mBlock5 for <your product>
// codes make you happy

#include <Arduino.h>
#include <Wire.h>
#include <SoftwareSerial.h>

float in1 = 0;
float in2 = 0;
float in3 = 0;
float in4 = 0;
float bt = 0;

void left (){
  digitalWrite(in1,0);
  digitalWrite(in2,1);
  digitalWrite(in3,1);
  digitalWrite(in4,0);

}

void right (){
  digitalWrite(in1,1);
  digitalWrite(in2,0);
  digitalWrite(in3,0);
  digitalWrite(in4,1);

}
void forward (){
  digitalWrite(in1,1);
  digitalWrite(in2,0);
  digitalWrite(in3,1);
  digitalWrite(in4,0);

}
void stoped (){
  digitalWrite(in1,0);
  digitalWrite(in2,0);
  digitalWrite(in3,0);
  digitalWrite(in4,0);

}
void backward (){
  digitalWrite(in1,0);
  digitalWrite(in2,1);
  digitalWrite(in3,0);
  digitalWrite(in4,1);

}

void _delay(float seconds) {
  long endTime = millis() + seconds * 1000;
  while(millis() < endTime) _loop();
}

void setup() {
  pinMode(in1,OUTPUT);
  pinMode(in2,OUTPUT);
  pinMode(in3,OUTPUT);
  pinMode(in4,OUTPUT);
  Serial.begin(9600);
  in1 = 12;
  in2 = 11;
  in3 = 10;
  in4 = 9;

  while(1) {
      if(Serial.available() > 0){
          bt = Serial.read();

      }
      if(bt == toascii(String("F")[0])){
          forward();

      }
      if(bt == toascii(String("B")[0])){
          backward();

      }
      if(bt == toascii(String("R")[0])){
          right();

      }
      if(bt == toascii(String("L")[0])){
          left();

      }
      if(bt == toascii(String("S")[0])){
          stoped();

      }

      _loop();
  }

}

void _loop() {
}

void loop() {
  _loop();
}
